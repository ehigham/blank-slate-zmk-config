## config/west.yml
```yaml
manifest:
  remotes:
    - name: zmkfirmware
      url-base: https://github.com/zmkfirmware
      
    - name: urob
      url-base: https://github.com/urob

    - name: petejohanson
      url-base: https://github.com/petejohanson
    
  projects:
    - name: zmk
      remote: zmkfirmware
      revision: v0.2.1
      import: app/west.yml

    - name: zephyr
      remote: zmkfirmware
      revision: v3.5.0+zmk-fixes
      clone-depth: 1
      import:
        name-blocklist:
          - ci-tools
          - hal_altera
          - hal_cypress
          - hal_infineon
          - hal_microchip
          - hal_nxp
          - hal_openisa
          - hal_silabs
          - hal_xtensa
          - hal_st
          - hal_ti
          - loramac-node
          - mcuboot
          - mcumgr
          - net-tools
          - openthread
          - edtt
          - trusted-firmware-m

    # modules
    - name: zmk-helpers
      remote: urob
      revision: main
      path: modules/zmk-helpers

    - name: blank-slate-zmk-module
      remote: petejohanson
      revision: main
      path: modules/blank-slate-zmk-module
      
  self:
    path: config
```
